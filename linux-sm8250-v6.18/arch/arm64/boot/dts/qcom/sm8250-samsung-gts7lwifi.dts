// SPDX-License-Identifier: BSD-3-Clause
/*
 * Samsung Galaxy Tab S7 Wi-Fi (SM-T870, gts7lwifi)
 * Copyright (c) 2024, The Linux Foundation
 */

/dts-v1/;

#include "sm8250-samsung-gts7-common.dtsi"

/ {
	model = "Samsung Galaxy Tab S7 Wi-Fi";
	compatible = "samsung,gts7lwifi", "qcom,sm8250";

	/*
	 * msm-id: SM8250 v2.1 (0x164 = 356)
	 * board-id: 0 0 like the vendor base DTB (androidboot.dtb_idx=0). The
	 * bootloader picks the DTBO entry whose own root qcom,board-id is 8 7
	 * (revision 7, androidboot.dtbo_idx=6) and applies it on top, so 8 7 is
	 * the post-overlay value seen in /proc/device-tree, not the base value.
	 */
	qcom,msm-id = <0x164 0x20001>;
	qcom,board-id = <0 0>;
};
