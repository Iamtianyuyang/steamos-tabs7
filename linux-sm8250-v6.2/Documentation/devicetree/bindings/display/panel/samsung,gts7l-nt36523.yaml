## linux-sm8250-v6.2/Documentation/devicetree/bindings/display/panel/samsung,gts7l-nt36523.yaml
```yaml
# SPDX-License-Identifier: GPL-2.0-only OR BSD-2-Clause
%YAML 1.2
---
$id: http://devicetree.org/schemas/display/panel/samsung,gts7l-nt36523.yaml#
$schema: http://devicetree.org/meta-schemas/core.yaml#

title: Novatek NT36523 based panel in the Samsung Galaxy Tab S7 (SM-T870)

maintainers:
  - tianyuyang <tianyuyang666@gmail.com>

description:
  Dual-DSI video mode panel driven by a Novatek NT36523 controller IC
  (Samsung PPA957DB1, 1600x2560, 3 C-PHY trios per link). The init sequence and
  timings are generated from the downstream driver by
  scripts/steamos/emit-panel-seq.py.

allOf:
  - $ref: panel-common.yaml#

properties:
  compatible:
    const: samsung,gts7l-nt36523

  reg:
    maxItems: 1

  reset-gpios:
    description: panel reset, active low

  vddio-supply:
    description: 1.8 V panel IO rail (downstream "vddlcd")

  buck-supply:
    description: switched panel buck rail (downstream "buck")

  ports:
    $ref: /schemas/graph.yaml#/properties/ports
    properties:
      port@0:
        $ref: /schemas/graph.yaml#/properties/port
        description: primary DSI link, carries the init sequence
      port@1:
        $ref: /schemas/graph.yaml#/properties/port
        description: secondary DSI link

    required:
      - port@0
      - port@1

required:
  - compatible
  - reg
  - reset-gpios
  - vddio-supply
  - buck-supply
  - ports

additionalProperties: false

examples:
  - |
    #include <dt-bindings/gpio/gpio.h>

    panel@0 {
        compatible = "samsung,gts7l-nt36523";
        reg = <0>;
        reset-gpios = <&tlmm 82 GPIO_ACTIVE_LOW>;
        vddio-supply = <&panel_vddio>;
        buck-supply = <&panel_buck>;

        ports {
            #address-cells = <1>;
            #size-cells = <0>;

            port@0 {
                reg = <0>;
                endpoint {
                    remote-endpoint = <&dsi0_out>;
                };
            };

            port@1 {
                reg = <1>;
                endpoint {
                    remote-endpoint = <&dsi1_out>;
                };
            };
        };
    };
...
```
