// SPDX-License-Identifier: BSD-3-Clause
/*
 * Samsung Galaxy Tab S7 Wi-Fi (SM-T870, gts7lwifi)
 * Copyright (c) 2024, The Linux Foundation
 */

/dts-v1/;

#include "sm8250-samsung-gts7-common.dtsi"

/ {
	model = "Samsung Galaxy Tab S7 Wi-Fi";
	compatible = "samsung,gts7lwifi", "qcom,sm8250";

	/*
	 * msm-id: SM8250 v2.1 (0x164 = 356)
	 * board-id: Wi-Fi EUR revision 7, matching ro.boot.revision on the
	 * development tablet and kona-sec-gts7lwifi-eur-overlay-r07.dts.
	 */
	qcom,msm-id = <0x164 0x20001>;
	qcom,board-id = <8 7>;
};
